## src/boards/arm/move_sensor/Kconfig.defconfig
```kconfig
# Copyright (c) 2023 Nordic Semiconductor ASA
# SPDX-License-Identifier: Apache-2.0

if BOARD_MOVE_SENSOR

config BOARD
	default "move_sensor"

config BT_CTLR
   default BT

endif
```
